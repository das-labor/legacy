## microcontroller/src-atmel/borg/borgconf/borg_hw/config.in
```kconfig
###################### Borg Hardware Menu #####################################
mainmenu_option next_comment
comment "Borg Hardware"

int "Number of rows   " NUM_ROWS 16
int "Number of columns" NUM_COLS 16
int "Number of brightnes-levels" NUMPLANE 3



choice 'Hardware Driver'			\
   "Borg-16                HW_BORG_16 \
    Andre-borg             HW_BORG_ANDRE \
    Laufschrift-borg	     HW_BORG_LS \
    Borg-mini              HW_BORG_MINI" \
   'Borg-16' BORG_HW


if [ "$BORG_HW" == "HW_BORG_16" ] ; then
  source borg_hw/config_borg16.in
fi


#		case $x in
#		y) flag="*" ;;
#		m) flag="M" ;;
#		*) flag=" " ;;
#		esac




endmenu


###############################################################################
```

## microcontroller/src-atmel/borg/borgconf/config.in
```kconfig
mainmenu_name "Borg Configuration"

###################### General Setup Menu #####################################
mainmenu_option next_comment
comment "General Setup"

#bool 'Prompt for experimental code' CONFIG_EXPERIMENTAL

choice 'Target MCU'			\
   "ATmega8                atmega8	\
    ATmega32		           atmega32	\
    ATmega644              atmega644	\
    ATmega644p             atmega644p"	\
   'ATmega32' MCU 

int "MCU frequency" FREQ 16000000


endmenu
###############################################################################

###################### Borg Hardware Menu #####################################
source borg_hw/config.in
###############################################################################
```

## microcontroller/src-atmel/borg/borgconf/scrolltext/config.in
```kconfig
dep_bool_menu "Scrolltext Support" SCROLLTEXT_SUPPORT y

choice 'Scrolltext Font'			\
   'Arial-8              ARIAL8 \
    Small-6              SMALL6 \
    Uni-53               UNI53' \
   'Arial-8' SCROLLTEXT_FONT




endmenu
```

## microcontroller/src-atmel/borg/borgware-2d/borg_hw/config.in
```kconfig
###################### Borg Hardware Menu #####################################
mainmenu_option next_comment
comment "Borg Hardware"

uint "Number of rows   " NUM_ROWS 16
uint "Number of columns" NUM_COLS 16
int "Number of brightnes-levels" NUMPLANE 3



choice 'Hardware Driver'			\
   "Borg-16                HW_BORG_16 \
    Andre-Borg             HW_BORG_ANDRE \
    Laufschrift-Borg	   HW_BORG_LS \
    Laufschrift-Borg-MH    HW_BORG_MH \
    Borg-Mini              HW_BORG_MINI \
    Panel-One              HW_PANEL_ONE \
    4xPD1165               HW_PD1165 \
    Ping-Pong              HW_PINGPONG \
    Giga-Borg              HW_GIGABORG \
    Ancient-Borg           HW_ANCIENTBORG" \
   'Borg-16' BORG_HW


if [ "$BORG_HW" == "HW_BORG_16" ] ; then
  source borg_hw/config_borg16.in
fi

if [ "$BORG_HW" == "HW_BORG_ANDRE" ] ; then
  source borg_hw/config_andreborg.in
fi

if [ "$BORG_HW" == "HW_BORG_LS" ] ; then
  source borg_hw/config_borg_ls.in
fi

if [ "$BORG_HW" == "HW_BORG_MH" ] ; then
  source borg_hw/config_borg_mh.in
fi

if [ "$BORG_HW" == "HW_BORG_MINI" ] ; then
  source borg_hw/config_borg_mini.in
fi

if [ "$BORG_HW" == "HW_PANEL_ONE" ] ; then
  source borg_hw/config_panel_one.in
fi

if [ "$BORG_HW" == "HW_PD1165" ] ; then
  source borg_hw/config_pd1165.in
fi

if [ "$BORG_HW" == "HW_PINGPONG" ] ; then
  source borg_hw/config_pingpong.in
fi

if [ "$BORG_HW" == "HW_ROTOR" ] ; then
  source borg_hw/config_rotor.in
fi

if [ "$BORG_HW" == "HW_GIGABORG" ] ; then
  source borg_hw/config_gigaborg.in
fi

if [ "$BORG_HW" == "HW_ANCIENTBORG" ] ; then
  source borg_hw/config_ancient.in
fi

endmenu


###############################################################################
```

## microcontroller/src-atmel/borg/borgware-2d/can/config.in
```kconfig
dep_bool_menu "CAN bus support" CAN_SUPPORT y

if [ "$CAN_SUPPORT" = "y" ]; then
   bool 'Use MCU builtin SPI support' SPI_HARDWARE

   choice 'SPI Port'			\
      "PORTA  0 \
       PORTB  1 \
       PORTC  2 \
       PORTD  3" \
      'PORTB' SPI_PORTIDX

   choice 'Bit MOSI'			\
      "Bit0 0 \
       Bit1 1 \
       Bit2 2 \
       Bit3 3 \
       Bit4 4 \
       Bit5 5 \
       Bit6 6 \
       Bit7 7" \
      'Bit5' SPI_PIN_MOSI

   choice 'Bit MISO'			\
      "Bit0 0 \
       Bit1 1 \
       Bit2 2 \
       Bit3 3 \
       Bit4 4 \
       Bit5 5 \
       Bit6 6 \
       Bit7 7" \
      'Bit6' SPI_PIN_MISO

   choice 'Bit SCK'			\
      "Bit0 0 \
       Bit1 1 \
       Bit2 2 \
       Bit3 3 \
       Bit4 4 \
       Bit5 5 \
       Bit6 6 \
       Bit7 7" \
      'Bit7' SPI_PIN_SCK

   choice 'Bit SS'			\
      "Bit0 0 \
       Bit1 1 \
       Bit2 2 \
       Bit3 3 \
       Bit4 4 \
       Bit5 5 \
       Bit6 6 \
       Bit7 7" \
      'Bit4' SPI_PIN_SS

   bool "Use AVR hardware interrupt" CAN_INTERRUPT

   choice 'MCP Interrupt Port'			\
	 "PINA  PINA \
	  PINB  PINB \
	  PINC  PINC \
	  PIND  PIND" \
	 'PIND' SPI_REG_PIN_MCP_INT

   choice 'MCP Interrupt Bit'			\
	 "Bit0 0 \
	  Bit1 1 \
	  Bit2 2 \
	  Bit3 3 \
	  Bit4 4 \
	  Bit5 5 \
	  Bit6 6 \
	  Bit7 7" \
	 'Bit2' SPI_PIN_MCP_INT
fi
endmenu
```

## microcontroller/src-atmel/borg/borgware-2d/config.in
```kconfig
mainmenu_name "Borg Configuration"

### General Setup Menu ########################################################
mainmenu_option next_comment
comment "General Setup"
	#bool 'Prompt for experimental code' CONFIG_EXPERIMENTAL

	choice 'Target MCU'           \
 	  "ATmega8        atmega8     \
	   ATmega32       atmega32    \
	   ATmega644      atmega644   \
	   ATmega644p     atmega644p  \
	   ATmega8515     atmega8515" \
	   'ATmega32' MCU

	int "MCU frequency" FREQ 16000000
endmenu
###############################################################################


### Borg Hardware Menu ########################################################
source borg_hw/config.in
###############################################################################


### Features Menu #############################################################
mainmenu_option next_comment
comment "Features"
	bool     "prng random number generator" RANDOM_SUPPORT y
	dep_bool "CAN Time Extension"   LAP_TIME_EXTENSION $CAN_SUPPORT
endmenu
###############################################################################


### Scrolltext Menu ###########################################################
source scrolltext/config.in
###############################################################################


### Joystick Menu #############################################################
source joystick/config.in
###############################################################################


### CAN Menu ##################################################################
source can/config.in
###############################################################################


### Borg Menu #################################################################
dep_bool "Menu Support" MENU_SUPPORT $JOYSTICK_SUPPORT
depends on JOYSTICK_SUPPORT
###############################################################################


### Game Menu #################################################################
source games/config.in
###############################################################################


### Animations Menu ###########################################################
source animations/config.in
###############################################################################


### small Animations Menu #####################################################
source smallani/config.in
###############################################################################
```

## microcontroller/src-atmel/borg/borgware-2d/joystick/config.in
```kconfig
dep_bool_menu "joystick support" JOYSTICK_SUPPORT y

if [ "$JOYSTICK_SUPPORT" = "y" ]; then
###################### Parallel joystick menu #################################
   dep_bool_menu "parallel joystick support" PARALLEL_JOYSTICK_SUPPORT y

   if [ "$PARALLEL_JOYSTICK_SUPPORT" = "y" ]; then
      choice 'Pin up'			\
         "PINA  PINA \
          PINB  PINB \
          PINC  PINC \
          PIND  PIND" \
         'PINB' JOYSTICK_PIN_UP

      choice 'Bit up'			\
         "Bit0 0 \
          Bit1 1 \
          Bit2 2 \
          Bit3 3 \
          Bit4 4 \
          Bit5 5 \
          Bit6 6 \
          Bit7 7" \
         'Bit0' JOYSTICK_BIT_UP

      choice 'Pin down'			\
         "PINA  PINA \
          PINB  PINB \
          PINC  PINC \
          PIND  PIND" \
         'PINB' JOYSTICK_PIN_DOWN

      choice 'Bit down'			\
         "Bit0 0 \
          Bit1 1 \
          Bit2 2 \
          Bit3 3 \
          Bit4 4 \
          Bit5 5 \
          Bit6 6 \
          Bit7 7" \
         'Bit1' JOYSTICK_BIT_DOWN

      choice 'Pin left'			\
         "PINA  PINA \
          PINB  PINB \
          PINC  PINC \
          PIND  PIND" \
         'PINB' JOYSTICK_PIN_LEFT

      choice 'Bit left'			\
         "Bit0 0 \
          Bit1 1 \
          Bit2 2 \
          Bit3 3 \
          Bit4 4 \
          Bit5 5 \
          Bit6 6 \
          Bit7 7" \
         'Bit2' JOYSTICK_BIT_LEFT

      choice 'Pin right'			\
         "PINA  PINA \
          PINB  PINB \
          PINC  PINC \
          PIND  PIND" \
         'PINB' JOYSTICK_PIN_RIGHT

      choice 'Bit right'			\
         "Bit0 0 \
          Bit1 1 \
          Bit2 2 \
          Bit3 3 \
          Bit4 4 \
          Bit5 5 \
          Bit6 6 \
          Bit7 7" \
         'Bit3' JOYSTICK_BIT_RIGHT

      choice 'Pin fire'			\
         "PINA  PINA \
          PINB  PINB \
          PINC  PINC \
          PIND  PIND" \
         'PIND' JOYSTICK_PIN_FIRE

      choice 'Bit fire'			\
         "Bit0 0 \
          Bit1 1 \
          Bit2 2 \
          Bit3 3 \
          Bit4 4 \
          Bit5 5 \
          Bit6 6 \
          Bit7 7" \
         'Bit3' JOYSTICK_BIT_FIRE
   fi

   endmenu
###############################################################################

###################### NES-Pad menu #################################
   dep_bool_menu "nes-pad support" NES_PAD_SUPPORT y

   if [ "$NES_PAD_SUPPORT" = "y" ]; then
      choice 'Port clk'			\
         "PORTA  PORTA \
          PORTB  PORTB \
          PORTC  PORTC \
          PORTD  PORTD" \
         'PORTB' NES_PAD_PORT_CLK

      choice 'Port ds'			\
         "PORTA  PORTA \
          PORTB  PORTB \
          PORTC  PORTC \
          PORTD  PORTD" \
         'PORTB' NES_PAD_PORT_PL 

      choice 'Pin pl'			\
         "PORTA  PORTA \
          PORTB  PORTB \
          PORTC  PORTC \
          PORTD  PORTD" \
         'PORTB' NES_PAD_PORT_DS

      choice 'Bit clk'			\
         "Bit0 0 \
          Bit1 1 \
          Bit2 2 \
          Bit3 3 \
          Bit4 4 \
          Bit5 5 \
          Bit6 6 \
          Bit7 7" \
         'Bit0' NES_PAD_BIT_CLK

      choice 'Bit pl'			\
         "Bit0 0 \
          Bit1 1 \
          Bit2 2 \
          Bit3 3 \
          Bit4 4 \
          Bit5 5 \
          Bit6 6 \
          Bit7 7" \
         'Bit1' NES_PAD_BIT_PL

      choice 'Bit ds'			\
         "Bit0 0 \
          Bit1 1 \
          Bit2 2 \
          Bit3 3 \
          Bit4 4 \
          Bit5 5 \
          Bit6 6 \
          Bit7 7" \
         'Bit2' NES_PAD_BIT_DS

   fi

   endmenu
###############################################################################

###################### RFM12 joystick menu ####################################
   dep_bool_menu "RFM12 Joystick support" RFM12_JOYSTICK_SUPPORT y

   endmenu


fi

endmenu
```

## microcontroller/src-atmel/borg/borgware-2d/rfm12/config.in
```kconfig
dep_bool_menu "RFM12 Support" RFM12_SUPPORT y

if [ "$RFM12_SUPPORT" = "y" ]; then

	choice 'SPI Port'			\
	 "PORTA  PORTA \
	  PORTB  PORTB \
	  PORTC  PORTC \
	  PORTD  PORTD" \
	 'PORTB' PORT_SPI
  
	choice 'SPI SS Bit'			\
	 "Bit0 0 \
	  Bit1 1 \
	  Bit2 2 \
	  Bit3 3 \
	  Bit4 4 \
	  Bit5 5 \
	  Bit6 6 \
	  Bit7 7" \
	 'Bit4' BIT_SPI_SS

	choice 'MOSI Bit'			\
	 "Bit0 0 \
	  Bit1 1 \
	  Bit2 2 \
	  Bit3 3 \
	  Bit4 4 \
	  Bit5 5 \
	  Bit6 6 \
	  Bit7 7" \
	 'Bit5' BIT_MOSI

	choice 'MISO Bit'			\
	 "Bit0 0 \
	  Bit1 1 \
	  Bit2 2 \
	  Bit3 3 \
	  Bit4 4 \
	  Bit5 5 \
	  Bit6 6 \
	  Bit7 7" \
	 'Bit6' BIT_MISO

	choice 'SCK Bit'			\
	 "Bit0 0 \
	  Bit1 1 \
	  Bit2 2 \
	  Bit3 3 \
	  Bit4 4 \
	  Bit5 5 \
	  Bit6 6 \
	  Bit7 7" \
	 'Bit7' BIT_SCK

	choice 'RFM12 SS Port'			\
	 "PORTA  PORTA \
	  PORTB  PORTB \
	  PORTC  PORTC \
	  PORTD  PORTD" \
	 'PORTB' PORT_SS

	choice 'RFM12 SS Bit'			\
	 "Bit0 0 \
	  Bit1 1 \
	  Bit2 2 \
	  Bit3 3 \
	  Bit4 4 \
	  Bit5 5 \
	  Bit6 6 \
	  Bit7 7" \
	 'Bit4' BIT_SS




fi

endmenu
```

## microcontroller/src-atmel/borg/borgware-2d/scrolltext/config.in
```kconfig
dep_bool_menu "Scrolltext Support" SCROLLTEXT_SUPPORT y

if [ "$SCROLLTEXT_SUPPORT" = "y" ]; then
   choice 'Scrolltext Font'			\
      "Arial_8              FONT_ARIAL8 \
       Small_6              FONT_SMALL6 \
       Uni_53               FONT_UNI53 \
       C64                  FONT_C64" \
      'Arial_8' SCROLLTEXT_FONT

   int "Scrolltest buffer size" SCROLLTEXT_BUFFER_SIZE 128

   int "Default x speed" SCROLL_X_SPEED 20
   int "Default y speed" SCROLL_Y_SPEED 20

   string "Default text" SCROLLTEXT_TEXT "</#www.das-labor.org"

fi

endmenu
```
